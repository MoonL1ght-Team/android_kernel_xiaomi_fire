## drivers/dma-buf/heaps/Kconfig
```kconfig
config DMABUF_HEAPS_SYSTEM
	tristate "DMA-BUF System Heap"
	depends on DMABUF_HEAPS
	help
	  Choose this option to enable the system dmabuf heap. The system heap
	  is backed by pages from the buddy allocator. If in doubt, say Y.

config DMABUF_HEAPS_CMA
	tristate "DMA-BUF CMA Heap"
	depends on DMABUF_HEAPS && DMA_CMA
	help
	  Choose this option to enable dma-buf CMA heap. This heap is backed
	  by the Contiguous Memory Allocator (CMA). If your system has these
	  regions, you should say Y here.

config DMABUF_HEAPS_TEGRA_VPR_INIT
	bool "NVIDIA Tegra VPR reserved-memory initialization"
	depends on DMABUF_HEAPS && DMA_CMA
	help
	  Initialize the reserved-memory region used by the NVIDIA Tegra Video
	  Protection Region (VPR). This must be built into the kernel so a
	  vendor module can provide the VPR DMA-BUF heap after early boot.
```

## drivers/mtk-vendor/Kconfig
```kconfig
# SPDX-License-Identifier: GPL-2.0
menu "MediaTek vendor drivers for Xiaomi fire"

config FIRE_MTK_VENDOR_DRM
	bool "MediaTek mediatek_v2 display (DRM) driver"
	depends on DRM && ARCH_MEDIATEK
	select DRM_DISPLAY_DP_HELPER
	select DRM_DISPLAY_HELPER
	select DRM_GEM_DMA_HELPER
	select DRM_KMS_HELPER
	select DRM_MIPI_DSI
	select DRM_PANEL
	select VIDEOMODE_HELPERS
	help
	  Vendor mediatek_v2 DRM driver from kernel_device_modules-6.6,
	  needed by the Android hwcomposer on MT6768.

# Symbols the vendor Makefiles and sources key off.
config DEVICE_MODULES_DRM_MEDIATEK
	def_bool FIRE_MTK_VENDOR_DRM

config DRM_MEDIATEK_V2
	def_bool FIRE_MTK_VENDOR_DRM

config MTK_CMDQ_MBOX_EXT
	def_bool FIRE_MTK_VENDOR_DRM

config DEVICE_MODULES_MTK_SMI
	def_bool FIRE_MTK_VENDOR_DRM

config MTK_CMDQ_MBOX_EXT_MT6768
	def_bool MTK_CMDQ_MBOX_EXT

config DEVICE_MODULES_MTK_IOMMU
	def_bool FIRE_MTK_VENDOR_DRM
	select IOMMU_API
	select IOMMU_IO_PGTABLE_ARMV7S

config DEVICE_MODULES_MTK_SCPSYS
	bool "MediaTek vendor scpsys power domains (legacy MT6768 binding)"
	depends on ARCH_MEDIATEK
	select PM_GENERIC_DOMAINS
	select REGMAP
	default FIRE_MTK_VENDOR_DRM
	help
	  The stock fire device tree describes power domains with the old
	  "mediatek,mt6768-scpsys" binding, which the upstream drivers do
	  not handle. Display, SMI and GCE wait for it.

config MTK_MT6382_BDG
	bool "MT6382 display bridge (DSC) used on fire"
	depends on FIRE_MTK_VENDOR_DRM && SPI
	default y
	help
	  fire routes DSI through an MT6382 bridge that compresses frames with
	  VESA DSC; it is configured over SPI.

config DRM_PANEL_FIRE_M19A_42_03_0D
	bool "CSOT m19a 42-03-0d DSC video mode panel"
	depends on FIRE_MTK_VENDOR_DRM
	default y
	help
	  FT8720 1080x2460 panel of Xiaomi fire behind the MT6382 bridge,
	  reported by LK as dsi_panel_m19a_42_03_0d_dsc_vdo.

config FIRE_MTK_VENDOR_GPU
	bool "Mali-G52 GPU (MediaTek r49p1 DDK) and its MTK helpers"
	depends on FIRE_MTK_VENDOR_DRM && PM_DEVFREQ && DEVFREQ_THERMAL && SYNC_FILE
	default y
	help
	  mtk_gpu_hal, gpufreq v2_legacy for MT6768, GED and mali_kbase
	  r49p1, matching the stock libGLES_mali.

# Symbols the vendor GPU Makefiles and sources key off.
config MTK_GPU_SUPPORT
	def_bool FIRE_MTK_VENDOR_GPU

config MTK_GPU_LEGACY
	def_bool FIRE_MTK_VENDOR_GPU

config MTK_GPUFREQ_V2
	def_bool FIRE_MTK_VENDOR_GPU

config MTK_GPU_MT6768_SUPPORT
	def_bool FIRE_MTK_VENDOR_GPU

config MTK_GPU_COMMON_DVFS_SUPPORT
	def_bool FIRE_MTK_VENDOR_GPU

endmenu
```

## fire_rfkill_defconfig
```kconfig
CONFIG_RFKILL=m
CONFIG_SYSTEM_TRUSTED_KEYS="certs/fire_stock_module_signing.pem"
```
